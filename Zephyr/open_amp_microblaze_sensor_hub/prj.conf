## CMakeLists.txt
```
cmake_minimum_required(VERSION 3.20.0)
# Copyright (c) 2018 Nordic Semiconductor ASA
# Copyright (c) 2019 Linaro Limited
# Copyright 2022 NXP
#
# SPDX-License-Identifier: Apache-2.0
#

set(REMOTE_ZEPHYR_DIR ${CMAKE_CURRENT_BINARY_DIR}/../openamp_remote/zephyr)


find_package(Zephyr REQUIRED HINTS $ENV{ZEPHYR_BASE})
project(openamp)

message(STATUS "${BOARD} compile as Master in this sample")

if(CONFIG_INCLUDE_REMOTE_DIR)
  target_include_directories(zephyr_interface
    INTERFACE ${REMOTE_ZEPHYR_DIR}/include/public)
endif()

enable_language(C ASM)

target_include_directories(app PRIVATE src)

FILE(GLOB app_sources src/*.c)
target_sources(app PRIVATE ${app_sources})

#zephyr_linker_sources(SECTIONS src/linker.ld)
```

## prj.conf
```kconfig
CONFIG_STDOUT_CONSOLE=y
CONFIG_CBPRINTF_FP_SUPPORT=y
CONFIG_SPI=y
CONFIG_SENSOR=y
CONFIG_ADXL345=y
CONFIG_I2C=y
CONFIG_GPIO=y

CONFIG_PRINTK=y
CONFIG_IPM=y
CONFIG_TIMESLICE_SIZE=1
CONFIG_MAIN_STACK_SIZE=2048
CONFIG_HEAP_MEM_POOL_SIZE=8192
CONFIG_OPENAMP=y
CONFIG_OPENAMP_SLAVE=y
#CONFIG_OPENAMP_RSC_TABLE=y
#CONFIG_OPENAMP_RSC_TABLE_NUM_RPMSG_BUFF=8

#CONFIG_SYS_HEAP_RUNTIME_STATS=y
```

## src/main.c
```c
#include <stdio.h>
#include <stdlib.h>
#include <zephyr/device.h>
#include <zephyr/drivers/sensor.h>
#include <zephyr/sys/util_macro.h>
#include <zephyr/kernel.h>
#include <zephyr/sys/__assert.h>
#include <zephyr/drivers/gpio.h>

#include <openamp/open_amp.h>
// #include <metal/metal.h>
#include <metal/sleep.h>
#include <openamp/rpmsg_virtio.h>
#include "platform_info.h"
#include "rpmsg_sensor.h"

static struct rpmsg_endpoint sensor_ept;
static uint16_t seq = 0;

static void *platform;

static int sensor_rx_cb(struct rpmsg_endpoint *ept,
						void *data, size_t len,
						uint32_t src, void *priv)
{
	// rpmsg_send(ept, data, len);
	return RPMSG_SUCCESS;
}

/* 1 sec */
#define SLEEP_TIME_MS 1000

/*****LED GPIO*****/
/* The devicetree node identifier for the leds alises ("led0"...). */
#define LED0_NODE DT_ALIAS(led0)
#define LED1_NODE DT_ALIAS(led1)
#define LED2_NODE DT_ALIAS(led2)
#define LED3_NODE DT_ALIAS(led3)
#define LED4_NODE DT_ALIAS(led4)
#define LED5_NODE DT_ALIAS(led5)
#define LED6_NODE DT_ALIAS(led6)
#define LED7_NODE DT_ALIAS(led7)

/*****TEMPERATURE I2C*****/
#define DELAY_WITH_TRIGGER K_SECONDS(5)
#define DELAY_WITHOUT_TRIGGER K_SECONDS(1)
#define UCEL_PER_CEL 1000000
#define UCEL_PER_MCEL 1000
#define TEMP_INITIAL_CEL 21
#define TEMP_WINDOW_HALF_UCEL 500000

/*****LED GPIO*****/
static const struct gpio_dt_spec led0 = GPIO_DT_SPEC_GET(LED0_NODE, gpios);
static const struct gpio_dt_spec led1 = GPIO_DT_SPEC_GET(LED1_NODE, gpios);
static const struct gpio_dt_spec led2 = GPIO_DT_SPEC_GET(LED2_NODE, gpios);
static const struct gpio_dt_spec led3 = GPIO_DT_SPEC_GET(LED3_NODE, gpios);
static const struct gpio_dt_spec led4 = GPIO_DT_SPEC_GET(LED4_NODE, gpios);
static const struct gpio_dt_spec led5 = GPIO_DT_SPEC_GET(LED5_NODE, gpios);
static const struct gpio_dt_spec led6 = GPIO_DT_SPEC_GET(LED6_NODE, gpios);
static const struct gpio_dt_spec led7 = GPIO_DT_SPEC_GET(LED7_NODE, gpios);

int gpio_leds_are_ready()
{
	if (!gpio_is_ready_dt(&led0))
	{
		return 0;
	}
	if (!gpio_is_ready_dt(&led1))
	{
		return 0;
	}
	if (!gpio_is_ready_dt(&led2))
	{
		return 0;
	}
	if (!gpio_is_ready_dt(&led3))
	{
		return 0;
	}
	if (!gpio_is_ready_dt(&led4))
	{
		return 0;
	}
	if (!gpio_is_ready_dt(&led5))
	{
		return 0;
	}
	if (!gpio_is_ready_dt(&led6))
	{
		return 0;
	}
	if (!gpio_is_ready_dt(&led7))
	{
		return 0;
	}
	return 1;
}

int gpio_leds_pin_configure()
{
	int ret;
	ret = gpio_pin_configure_dt(&led0, GPIO_OUTPUT_ACTIVE);
	if (ret < 0)
	{
		return 0;
	}
	ret = gpio_pin_configure_dt(&led1, GPIO_OUTPUT_ACTIVE);
	if (ret < 0)
	{
		return 0;
	}
	ret = gpio_pin_configure_dt(&led2, GPIO_OUTPUT_ACTIVE);
	if (ret < 0)
	{
		return 0;
	}
	ret = gpio_pin_configure_dt(&led3, GPIO_OUTPUT_ACTIVE);
	if (ret < 0)
	{
		return 0;
	}
	ret = gpio_pin_configure_dt(&led4, GPIO_OUTPUT_ACTIVE);
	if (ret < 0)
	{
		return 0;
	}
	ret = gpio_pin_configure_dt(&led5, GPIO_OUTPUT_ACTIVE);
	if (ret < 0)
	{
		return 0;
	}
	ret = gpio_pin_configure_dt(&led6, GPIO_OUTPUT_ACTIVE);
	if (ret < 0)
	{
		return 0;
	}
	ret = gpio_pin_configure_dt(&led7, GPIO_OUTPUT_ACTIVE);
	if (ret < 0)
	{
		return 0;
	}
	return 1;
}

/*Show the binary value of the temperature on the GPIO LED module*/
int toggle_gpio_temp(int *temp_bin_tab)
{
	int ret;
	if (temp_bin_tab[0])
	{
		ret = gpio_pin_toggle_dt(&led0);
		if (ret < 0)
		{
			return 0;
		}
	}
	if (temp_bin_tab[1])
	{
		ret = gpio_pin_toggle_dt(&led1);
		if (ret < 0)
		{
			return 0;
		}
	}
	if (temp_bin_tab[2])
	{
		ret = gpio_pin_toggle_dt(&led2);
		if (ret < 0)
		{
			return 0;
		}
	}
	if (temp_bin_tab[3])
	{
		ret = gpio_pin_toggle_dt(&led3);
		if (ret < 0)
		{
			return 0;
		}
	}
	if (temp_bin_tab[4])
	{
		ret = gpio_pin_toggle_dt(&led4);
		if (ret < 0)
		{
			return 0;
		}
	}
	if (temp_bin_tab[5])
	{
		ret = gpio_pin_toggle_dt(&led5);
		if (ret < 0)
		{
			return 0;
		}
	}
	if (temp_bin_tab[6])
	{
		ret = gpio_pin_toggle_dt(&led6);
		if (ret < 0)
		{
			return 0;
		}
	}
	if (temp_bin_tab[7])
	{
		ret = gpio_pin_toggle_dt(&led7);
		if (ret < 0)
		{
			return 0;
		}
	}
	return 1;
}

/*****TEMPERATURE I2C*****/
int temp_int;

K_SEM_DEFINE(sem, 0, 1);

static void trigger_handler(const struct device *dev,
							const struct sensor_trigger *trigger)
{
	k_sem_give(&sem);
}

static int low_ucel;
static int high_ucel;

static int sensor_set_attribute(const struct device *dev,
								enum sensor_channel chan,
								enum sensor_attribute attr, int value)
{
	struct sensor_value sensor_val;
	int ret;

	sensor_val.val1 = value / UCEL_PER_CEL;
	sensor_val.val2 = value % UCEL_PER_CEL;

	ret = sensor_attr_set(dev, chan, attr, &sensor_val);
	if (ret)
	{
		printf("sensor_attr_set failed ret %d\n", ret);
	}

	return ret;
}

static bool temp_in_window(const struct sensor_value *val)
{
	int temp_ucel = val->val1 * UCEL_PER_CEL + val->val2;

	return (temp_ucel >= low_ucel) && (temp_ucel <= high_ucel);
}

static int sensor_set_window(const struct device *dev,
							 const struct sensor_value *val)
{
	int temp_ucel = val->val1 * UCEL_PER_CEL + val->val2;

	low_ucel = temp_ucel - TEMP_WINDOW_HALF_UCEL;
	high_ucel = temp_ucel + TEMP_WINDOW_HALF_UCEL;

	int rc = sensor_set_attribute(dev, SENSOR_CHAN_AMBIENT_TEMP,
								  SENSOR_ATTR_UPPER_THRESH, high_ucel);

	if (rc == 0)
	{
		sensor_set_attribute(dev, SENSOR_CHAN_AMBIENT_TEMP,
							 SENSOR_ATTR_LOWER_THRESH, low_ucel);
	}

	if (rc == 0)
	{
		printk("Alert on temp outside [%d, %d] mCel\n",
			   low_ucel / UCEL_PER_MCEL,
			   high_ucel / UCEL_PER_MCEL);
	}

	return rc;
}

static void process_temp_iic(const struct device *dev, struct sensor_packet *pkt)
{
	struct sensor_value temp_val;
	int ret;
	bool reset_window = false;

	/* Set update rate to 240 mHz */
	sensor_set_attribute(dev, SENSOR_CHAN_AMBIENT_TEMP,
						 SENSOR_ATTR_SAMPLING_FREQUENCY, 240 * 1000);

	if (IS_ENABLED(CONFIG_ADT7420_TRIGGER))
	{
		struct sensor_trigger trig = {
			.type = SENSOR_TRIG_THRESHOLD,
			.chan = SENSOR_CHAN_AMBIENT_TEMP,
		};
		struct sensor_value val = {
			.val1 = TEMP_INITIAL_CEL,
		};

		ret = sensor_set_window(dev, &val);
		if (ret == 0)
		{
			ret = sensor_trigger_set(dev, &trig, trigger_handler);
		}
		if (ret != 0)
		{
			printf("Could not set trigger\n");
			return;
		}
	}

	ret = sensor_sample_fetch(dev);
	if (ret)
	{
		printf("sensor_sample_fetch failed ret %d\n", ret);
		return;
	}

	ret = sensor_channel_get(dev, SENSOR_CHAN_AMBIENT_TEMP,
							 &temp_val);
	if (ret)
	{
		// printf("sensor_channel_get failed ret %d\n", ret);
		return;
	}

	if (IS_ENABLED(CONFIG_ADT7420_TRIGGER))
	{
		reset_window |= !temp_in_window(&temp_val);
	}

	printf("Temperature : \n[°C]      %.6f %s\n",
		   sensor_value_to_double(&temp_val),
		   reset_window ? ": NEED RESET" : "");

	/* get sensor value (value1 and value2) combined as milli */
	pkt->temperature = (int32_t)sensor_value_to_milli(&temp_val);

	temp_int = temp_val.val1;

	if (IS_ENABLED(CONFIG_ADT7420_TRIGGER))
	{
		if (reset_window)
		{
			ret = sensor_set_window(dev, &temp_val);
		}
		if (ret)
		{
			printf("Window update failed ret %d\n", ret);
			return;
		}

		printk("Wait for trigger...");
		ret = k_sem_take(&sem, DELAY_WITH_TRIGGER);
		reset_window = (ret == 0);
		printk("%s\n", reset_window ? "ALERTED!" : "timed-out");
	}
}

// Convert the last 2 digits of a decimal number to binary
void dec2LastDigitToBinary(int n, int *binaryNum)
{
	int n_2digit = n % 100;					   // 2 last digits of the number
	int nullTab[8] = {0, 0, 0, 0, 0, 0, 0, 0}; // array to store binary number
	int i = 0;								   // counter for binary array

	// reset binary number tab values to 0
	for (int j = 0; j < 8; j++)
	{
		binaryNum[j] = nullTab[j];
	}

	while (n_2digit > 0)
	{
		// storing remainder in binary array
		binaryNum[i] = n_2digit % 2;
		n_2digit = n_2digit / 2;
		i++;
	}
}

/*****ACCELERATION SPI*****/
static const enum sensor_channel channels[] = {
	SENSOR_CHAN_ACCEL_X,
	SENSOR_CHAN_ACCEL_Y,
	SENSOR_CHAN_ACCEL_Z,
};

static int process_accel_spi(const struct device *dev, struct sensor_packet *pkt)
{
	int ret;
	struct sensor_value accel[3];

	ret = sensor_sample_fetch(dev);
	if (ret < 0)
	{
		printk("%s: sensor_sample_fetch() failed: %d\n", dev->name, ret);
		return ret;
	}

	for (size_t i = 0; i < ARRAY_SIZE(channels); i++)
	{
		ret = sensor_channel_get(dev, channels[i], &accel[i]);
		if (ret < 0)
		{
			printk("%s: sensor_channel_get(%c) failed: %d\n", dev->name, 'X' + i, ret);
			return ret;
		}
	}

	printk("Acceleration : \n[m/s^2]%12.6f %12.6f %12.6f \n[g]    %12.6f %12.6f %12.6f\n",
		   sensor_value_to_double(&accel[0]), sensor_value_to_double(&accel[1]), sensor_value_to_double(&accel[2]),
		   sensor_value_to_double(&accel[0]) / 9.81, sensor_value_to_double(&accel[1]) / 9.81, sensor_value_to_double(&accel[2]) / 9.81);

	/* get sensor value (value1 and value2) for acceleration and combined as milli */
	pkt->accel_x = (int32_t)sensor_value_to_milli(&accel[0]);
	pkt->accel_y = (int32_t)sensor_value_to_milli(&accel[1]);
	pkt->accel_z = (int32_t)sensor_value_to_milli(&accel[2]);

	return 0;
}

int main(int argc, char *argv[])
{
	printk("Beginning application\n");
	int ret;

	// Openamp init
	struct rpmsg_device *rdev;
	struct sensor_packet pkt;

	ret = platform_init(argc, argv, &platform);

	rdev = platform_create_rpmsg_vdev(platform,
									  0,				 /* vdev index */
									  VIRTIO_DEV_DEVICE, /* REMOTE role */
									  NULL,				 /* reset cb */
									  NULL);			 /* ns bind cb */

	if (!rdev)
	{
		while (1)
			;
	}

	ret = rpmsg_create_ept(&sensor_ept,
						   rdev,
						   "rpmsg-sensor",
						   RPMSG_ADDR_ANY,
						   RPMSG_ADDR_ANY,
						   sensor_rx_cb,
						   NULL);

	/* WAIT for Linux to bind */
	while (!is_rpmsg_ept_ready(&sensor_ept))
	{
		platform_poll(platform);
	}

	/*****LED GPIO*****/
	if (!gpio_leds_are_ready())
	{
		return 0;
	}

	if (!gpio_leds_pin_configure())
	{
		return 0;
	}

	/*****TEMPERATURE I2C*****/
	const struct device *const dev_temp_iic = DEVICE_DT_GET_ONE(adi_adt7420);

	if (!device_is_ready(dev_temp_iic))
	{
		printk("sensor: device not ready.\n");
		return 0;
	}

	// printf("device is %p, name is %s\n", dev_temp_iic, dev_temp_iic->name);

	int temp_binary[8] = {0, 0, 0, 0, 0, 0, 0, 0};

	/*****ACCELERATION SPI*****/
	const struct device *const dev_accel_spi = DEVICE_DT_GET_ONE(adi_adxl345);

	if (!device_is_ready(dev_accel_spi))
	{
		printk("sensor: device not ready.\n");
		return 0;
	}
	// printf("device is %p, name is %s\n", dev_accel_spi, dev_accel_spi->name);

	while (1)
	{
		/*****LED GPIO*****/
		if (!toggle_gpio_temp(temp_binary))
			return 0; // turn of the LEDs we turned on on the previous iteration of the while loop

		pkt.magic = RPMSG_SENSOR_MAGIC;
		pkt.seq = seq++;

		/*****TEMPERATURE I2C*****/
		process_temp_iic(dev_temp_iic, &pkt);
		dec2LastDigitToBinary(temp_int, temp_binary);
		printf("\n");

		/*****LED GPIO*****/
		if (!toggle_gpio_temp(temp_binary))
			return 0; // turn on some LEDs to show the binary value of the temperature

		/*****ACCELERATION SPI*****/
		ret = process_accel_spi(dev_accel_spi, &pkt);
		if (ret < 0)
		{
			return 0;
		}
		printf("\n  --------\n\n");

		/*****Sending sensor data packet to PS OpenAMP master *******/
		int ret = rpmsg_send(&sensor_ept,
							 &pkt,
							 sizeof(pkt));
		if (ret < 0)
		{
			printf("rpmsg_send failed: %d\r\n", ret);
		}

		k_msleep(SLEEP_TIME_MS);
	}
	return 0;
}
```

## src/platform_info.c
```c
/*
 * Copyright (c) 2020 Xilinx, Inc. All rights reserved.
 *
 * SPDX-License-Identifier: BSD-3-Clause
 */

/**************************************************************************
 * FILE NAME
 *
 *       platform_info.c
 *
 * DESCRIPTION
 *
 *       This file define platform specific data and implements APIs to set
 *       platform specific information for OpenAMP.
 *
 **************************************************************************/

#include <metal/atomic.h>
#include <metal/assert.h>
#include <metal/device.h>
#include <metal/irq.h>
#include <metal/utilities.h>
#include <openamp/rpmsg_virtio.h>
#include "platform_info.h"
#include "rsc_table.h"

#include <metal/log.h>
#include <zephyr/sys/sys_heap.h>

#define SHM_BASE_PA    0x2ED20000UL
#define SHM_TOTAL_SIZE 0x00060000UL

#define RSC_TABLE_PA      0x2ED20000UL
#define SHARED_BUF_OFFSET 0x00028000UL

/*
 * IPI information used by remoteproc operations.
 */
static struct remoteproc_priv rproc_priv = {};

static struct remoteproc rproc_inst;

static struct metal_io_region *shm_io;
static struct rpmsg_virtio_shm_pool shpool;

/* External functions */
extern int init_system(void);
extern void cleanup_system(void);

/*
 * processor operations from MicroBlaze to a53. It defines
 * notification operation and remote processor management operations.
 */
extern const struct remoteproc_ops zynqmp_mb_a53_proc_ops;

/* RPMsg virtio shared buffer pool */
static struct rpmsg_virtio_shm_pool shpool;

// Sanam - function for copying resource table to DDR
#define RSC_TABLE_DDR_PA 0x2ED20000UL

static void copy_rsc_table_to_ddr(void)
{
	int len;
	void *src = get_resource_table(0, &len);
	void *dst = (void *)RSC_TABLE_DDR_PA;

	memcpy(dst, src, len);

	/* Ensure visibility to Linux */
	metal_cache_flush(dst, len);
}

static struct remoteproc *platform_create_proc(int proc_index, int rsc_index)
{
	void *rsc_table;
	int rsc_size;
	int ret;
	metal_phys_addr_t pa;

	// Writing resource table in the DDR shared memory
	copy_rsc_table_to_ddr();

	(void)proc_index;
	rsc_table = (void *)RSC_TABLE_DDR_PA;
	rsc_size = sizeof(struct remote_resource_table);

	printf("Hello OpenAMP!\n");
	metal_log(METAL_LOG_DEBUG, "Metal log is alive\n");

	printf("RSC copied to DDR @ %p size %d\n", (void *)RSC_TABLE_DDR_PA, rsc_size);

	/* Initialize remoteproc instance */
	if (!remoteproc_init(&rproc_inst, &zynqmp_mb_a53_proc_ops, &rproc_priv)) {
		return NULL;
	}

	/* Map ALL shared memory once */
	pa = SHM_BASE_PA;
	if (!remoteproc_mmap(&rproc_inst, &pa, NULL, SHM_TOTAL_SIZE,
			     NORM_NSHARED_NCACHE | PRIV_RW_USER_RW, &shm_io)) {
		return NULL;
	}

	/* parse resource table to remoteproc */
	ret = remoteproc_set_rsc_table(&rproc_inst, rsc_table, rsc_size);
	if (ret) {
		printf("Failed to initialize remoteproc\r\n");
		remoteproc_remove(&rproc_inst);
		return NULL;
	}

	printf("Initialize remoteproc successfully.\r\n");

	return &rproc_inst;
}

int platform_init(int argc, char *argv[], void **platform)
{
	unsigned long proc_id = 0;
	unsigned long rsc_id = 0;
	struct remoteproc *rproc;

	if (!platform) {
		printf("Failed to initialize platform,"
		       "NULL pointer to store platform data.\r\n");
		return -EINVAL;
	}
	/* Initialize HW system components */
	init_system();

	if (argc >= 2) {
		proc_id = strtoul(argv[1], NULL, 0);
	}

	if (argc >= 3) {
		rsc_id = strtoul(argv[2], NULL, 0);
	}

	rproc = platform_create_proc(proc_id, rsc_id);
	if (!rproc) {
		printf("Failed to create remoteproc device.\r\n");
		return -EINVAL;
	}
	*platform = rproc;
	return 0;
}

struct rpmsg_device *platform_create_rpmsg_vdev(void *platform, unsigned int vdev_index,
						unsigned int role,
						void (*rst_cb)(struct virtio_device *vdev),
						rpmsg_ns_bind_cb ns_bind_cb)
{
	struct remoteproc *rproc = platform;
	struct rpmsg_virtio_device *rpmsg_vdev;
	struct virtio_device *vdev;
	void *shbuf;
	// struct metal_io_region *shbuf_io;
	int ret;

	rpmsg_vdev = metal_allocate_memory(sizeof(*rpmsg_vdev));
	if (!rpmsg_vdev) {
		return NULL;
	}
	// shbuf_io = remoteproc_get_io_with_pa(rproc, SHARED_MEM_PA);
	// if (!shbuf_io)
	//	goto err1;
	// printf("writing data to shm_io -> DDR base address\n");
	// metal_io_write32(shm_io, 0, 0xDEADBEEF);

	shbuf = metal_io_phys_to_virt(shm_io, SHM_BASE_PA + SHARED_BUF_OFFSET);

	printf("creating remoteproc virtio\r\n");
	/* TODO: can we have a wrapper for the following two functions? */
	printf("[PLAT] rproc=%p vdev_index=%u role=%u\r\n", rproc, vdev_index, role);

	printf("[PLAT] rsc_table=%p rsc_io=%p\r\n", rproc->rsc_table, rproc->rsc_io);

	vdev = remoteproc_create_virtio(rproc, vdev_index, role, rst_cb);
	if (!vdev) {
		printf("failed remoteproc_create_virtio\r\n");
		goto err1;
	}

	printf("Fixing vring I/O regions\r\n");
	for (int i = 0; i < vdev->vrings_num; i++) {
		printf("  vring[%d]: old_io=%p -> new_io=%p\r\n", i, vdev->vrings_info[i].io,
		       shm_io);
		vdev->vrings_info[i].io = shm_io;
	}
	/*
	static struct metal_io_region vring_io_struct;
	static const metal_phys_addr_t vring_phys_addrs[] = { 0x2ed40000 };

	metal_io_init(&vring_io_struct,
			 (void *)0x2ed40000,
			 vring_phys_addrs,
			 0x10000,
			 -1,
			 0,
			 NULL);

	vdev->vrings_info[0].io = &vring_io_struct;
	vdev->vrings_info[1].io = &vring_io_struct;
	*/

	printf("initializing rpmsg shared buffer pool\r\n");
	/*
	 * Only RPMsg virtio driver needs to initialize the shared buffers
	 * pool
	 */
	rpmsg_virtio_init_shm_pool(&shpool, shbuf, (SHM_TOTAL_SIZE - SHARED_BUF_OFFSET));

	printf("initializing rpmsg vdev\r\n");
	/* RPMsg virtio device can set shared buffers pool argument to NULL */
	// Check if vring memory is properly defined
	printk("Vring info before create:\n");
	for (int i = 0; i < 2; i++) {
		struct virtio_vring_info *vring = &vdev->vrings_info[i];
		printk("  vring[%d]: io=%p, info=%p\n", i, (void *)vring->io, (void *)vring);
		printk("  vring[%d]: num=%u, align=%u\n", i, vring->info.num_descs,
		       vring->info.align);
		printk("  vring[%d]: vaddr=%p\n", i, vring->info.vaddr);
	}
	// metal_io_block_write(io_region, offset, data, len);
	// uint32_t data = 0x55A5A55A;
	// metal_io_block_write(shm_io, 0, &data, sizeof(data));
	// struct sys_memory_stats stats;
	// sys_memory_stats_get(&stats);

	// printk("[HEAP] free=%u used=%u max=%u\n", stats.free_bytes, stats.allocated_bytes,
	//        stats.max_allocated_bytes);
	// void *p1 = k_malloc(2104);
	// void *p2 = k_malloc(2104);

	// printk("p1=%p p2=%p\n", p1, p2);

	ret = rpmsg_init_vdev(rpmsg_vdev, vdev, ns_bind_cb, shm_io, &shpool);
	printf("rpmsg_init_vdev ret = %d\r\n", ret);

	if (ret) {
		printf("failed rpmsg_init_vdev\r\n");
		goto err2;
	}
	printf("initializing rpmsg vdev\r\n");
	return rpmsg_virtio_get_rpmsg_device(rpmsg_vdev);
err2:
	remoteproc_remove_virtio(rproc, vdev);
err1:
	metal_free_memory(rpmsg_vdev);
	return NULL;
}

int platform_poll(void *priv)
{
	struct remoteproc *rproc = priv;

	while (1) {
		char *done_polling = (char *)POLL_SHM_LOCATION;

		if (*done_polling) {
			remoteproc_get_notification(rproc, RSC_NOTIFY_ID_ANY);
			break;
		}
	}
	return 0;
}

void platform_release_rpmsg_vdev(struct rpmsg_device *rpdev, void *platform)
{
	struct rpmsg_virtio_device *rpvdev;
	struct remoteproc *rproc;

	rpvdev = metal_container_of(rpdev, struct rpmsg_virtio_device, rdev);
	rproc = platform;

	rpmsg_deinit_vdev(rpvdev);
	remoteproc_remove_virtio(rproc, rpvdev->vdev);
}

void platform_cleanup(void *platform)
{
	struct remoteproc *rproc = platform;

	if (rproc) {
		remoteproc_remove(rproc);
	}
	cleanup_system();
}
```

## src/platform_info.h
```c
/*
 * Copyright (c) 2020 Xilinx, Inc. All rights reserved.
 *
 * SPDX-License-Identifier: BSD-3-Clause
 */
#ifndef PLATFORM_INFO_H_
#define PLATFORM_INFO_H_

#include <openamp/remoteproc.h>
#include <openamp/virtio.h>
#include <openamp/rpmsg.h>

#include "platform_info_common.h"

#if defined __cplusplus
extern "C" {
#endif

/* MicroBlaze memory attributes. Depends on MB memory the design */
#define DEVICE_SHARED       0x00000001U /* device, shareable */
#define DEVICE_NONSHARED    0x00000010U /* device, non shareable */
#define NORM_NSHARED_NCACHE 0x00000008U /* Non cacheable  non shareable */
#define NORM_SHARED_NCACHE  0x0000000CU /* Non cacheable shareable */
#define PRIV_RW_USER_RW     (0x00000003U << 8U) /* Full Access */

#define POLL_SHM_LOCATION 0x2EE30000
#define POLL_STOP 0x1U

struct remoteproc_priv {
	const char *ipi_name; /**< IPI device name */
	const char *ipi_bus_name; /**< IPI bus name */
	struct metal_device *ipi_dev; /**< pointer to IPI device */
	struct metal_io_region *ipi_io; /**< pointer to IPI i/o region */
	unsigned int ipi_chn_mask; /**< IPI channel mask */
	atomic_int ipi_nokick;
};

#if defined __cplusplus
}
#endif

#endif /* PLATFORM_INFO_H_ */
```

## src/rpmsg_sensor.h
```c
/* rpmsg_sensor.h */
#ifndef RPMSG_SENSOR_H
#define RPMSG_SENSOR_H

#include <stdint.h>

#define RPMSG_SENSOR_MAGIC 0xA55A

struct __attribute__((packed)) sensor_packet {
    uint16_t magic;
    uint16_t seq;
    int32_t accel_x;   /* milli-g */
    int32_t accel_y;
    int32_t accel_z;
    int32_t temperature; /* milli-degree C */
};

#endif
```

## src/rsc_table.c
```c
#include <openamp/open_amp.h>
#include "rsc_table.h"

#define __section_t(S) __attribute__((__section__(#S)))
#define __resource __section_t(.resource_table)

#define RPMSG_VDEV_DFEATURES (1 << VIRTIO_RPMSG_F_NS)
#define VIRTIO_ID_RPMSG_ 7

#define VRING_ALIGN 0x1000
#define VRING_SIZE  256

#define RING_TX 0x2ed40000
#define RING_RX 0x2ed44000 

struct remote_resource_table __resource resources = {
    .version = 1,
    .num = 1,
    .reserved = {0, 0},

    .offset = {
        offsetof(struct remote_resource_table, rpmsg_vdev),
    },

    .rpmsg_vdev = {
        .type = RSC_VDEV,
        .id = VIRTIO_ID_RPMSG_,
        .notifyid = 31,
        .dfeatures = RPMSG_VDEV_DFEATURES,
        .gfeatures = 0,
        .config_len = 0,
        .status = 0,
        .num_of_vrings = 2,
        .reserved = {0, 0},
    },

    .rpmsg_vring0 = {
        .da = RING_TX,
        .align = VRING_ALIGN,
        .num = VRING_SIZE,
        .notifyid = 1,
        .reserved = 0,
    },

    .rpmsg_vring1 = {
        .da = RING_RX,
        .align = VRING_ALIGN,
        .num = VRING_SIZE,
        .notifyid = 2,
        .reserved = 0,
    },
};

void *get_resource_table(int rsc_id, int *len)
{
    (void)rsc_id;
    *len = sizeof(resources);
    return &resources;
}
```

## src/rsc_table.h
```c
/*
 * Copyright (C) 2020 Xilinx, Inc.  All rights reserved.
 *
 * SPDX-License-Identifier: BSD-3-Clause
 */

/*
 * Resource table declarations. Resource table is placed in a separate
 * section of a bare-metal binary or firmware. It's used to describe
 * shared memory (virtIO devices) resources the remoteproc host should
 * initialize and / or use to communicate with the firmware.
 */
#ifndef RSC_TABLE_H_
#define RSC_TABLE_H_

#include <stddef.h>
#include <openamp/open_amp.h>

#if defined __cplusplus
extern "C" {
#endif

#define NO_RESOURCE_ENTRIES         1

/* Resource table for the given remote */
struct __packed remote_resource_table {
	unsigned int version;
	unsigned int num;
	unsigned int reserved[2];
	unsigned int offset[NO_RESOURCE_ENTRIES];
	//struct resource_table base;
	/* rpmsg vdev entry */
	struct fw_rsc_vdev rpmsg_vdev;
	struct fw_rsc_vdev_vring rpmsg_vring0;
	struct fw_rsc_vdev_vring rpmsg_vring1;
};

void *get_resource_table(int rsc_id, int *len);

#if defined __cplusplus
}
#endif

#endif /* RSC_TABLE_H_ */
```
